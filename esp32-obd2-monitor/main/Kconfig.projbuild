## esp32-obd2-monitor/main/Kconfig.projbuild
```kconfig
menu "OBD2 Monitor Settings"

    config OBD2_WIFI_SSID
        string "WiFi SSID"
        default ""
        help
            WiFi SSID for OBD2 WiFi adapter connection

    config OBD2_WIFI_PASSWORD
        string "WiFi Password"
        default ""
        help
            WiFi password

    config OBD2_ADAPTER_IP
        string "OBD2 Adapter IP"
        default "192.168.0.10"
        help
            IP address of WiFi OBD2 adapter

    config OBD2_ADAPTER_PORT
        int "OBD2 Adapter Port"
        default 35000
        help
            TCP port of WiFi OBD2 adapter

    config OBD2_UART_BAUD
        int "OBD2 UART Baudrate"
        default 38400
        help
            UART baudrate for USB connection

endmenu
```

## esp32-obd2-monitor/sdkconfig.defaults
```kconfig
CONFIG_IDF_TARGET="esp32s3"

# Waveshare ESP32-S3-Touch-LCD-2.1: 8MB OPI PSRAM, 16MB flash
CONFIG_SPIRAM=y
CONFIG_SPIRAM_MODE_OCT=y
CONFIG_SPIRAM_SPEED_80M=y
CONFIG_SPIRAM_BOOT_INIT=y
CONFIG_SPIRAM_FETCH_INSTRUCTIONS=y
CONFIG_SPIRAM_RODATA=y
# Allow task stacks in PSRAM for large BLE/UI tasks
CONFIG_SPIRAM_ALLOW_STACK_EXTERNAL_MEMORY=y

CONFIG_ESP_DEFAULT_CPU_FREQ_MHZ_240=y
CONFIG_FREERTOS_HZ=1000
CONFIG_ESPTOOLPY_FLASHSIZE_16MB=y

# dashboard_init + LVGL on main needs extra stack
CONFIG_ESP_MAIN_TASK_STACK_SIZE=12288

CONFIG_PARTITION_TABLE_CUSTOM=y
CONFIG_PARTITION_TABLE_CUSTOM_FILENAME="partitions.csv"

# RGB LCD framebuffer in PSRAM
CONFIG_ESP32S3_DATA_CACHE_LINE_64B=y

# LVGL Montserrat fonts used by dashboard UI
CONFIG_LV_FONT_MONTSERRAT_10=y
CONFIG_LV_FONT_MONTSERRAT_12=y
CONFIG_LV_FONT_MONTSERRAT_14=y
CONFIG_LV_FONT_MONTSERRAT_16=y
CONFIG_LV_FONT_MONTSERRAT_20=y
CONFIG_LV_FONT_MONTSERRAT_24=y
CONFIG_LV_FONT_MONTSERRAT_28=y
CONFIG_LV_FONT_MONTSERRAT_32=y
CONFIG_LV_FONT_MONTSERRAT_48=y

# LVGL render cadence — lighter draw path (no debug overlay)
CONFIG_LV_DEF_REFR_PERIOD=16
CONFIG_LV_DRAW_SW_SHADOW_CACHE_SIZE=0
CONFIG_LV_OBJ_STYLE_CACHE=y
CONFIG_LV_USE_SYSMON=n
CONFIG_LV_USE_PERF_MONITOR=n
CONFIG_LV_MEM_SIZE_KILOBYTES=128

# Bluetooth (NimBLE) — full BLE 5.x central for all OBD adapter types
CONFIG_BT_ENABLED=y
CONFIG_BT_BLUEDROID_ENABLED=n
CONFIG_BT_NIMBLE_ENABLED=y
CONFIG_BT_CONTROLLER_ENABLED=y
CONFIG_BT_NIMBLE_ROLE_CENTRAL=y
CONFIG_BT_NIMBLE_ROLE_PERIPHERAL=y
CONFIG_BT_NIMBLE_ROLE_BROADCASTER=y
CONFIG_BT_NIMBLE_ROLE_OBSERVER=y
CONFIG_BT_NIMBLE_GATT_CLIENT=y
CONFIG_BT_NIMBLE_MAX_CONNECTIONS=3
CONFIG_BT_NIMBLE_HOST_TASK_STACK_SIZE=16384
CONFIG_BT_NIMBLE_ATT_PREFERRED_MTU=247
CONFIG_BT_NIMBLE_MEM_ALLOC_MODE_EXTERNAL=y
CONFIG_BT_NIMBLE_NVS_PERSIST=y
CONFIG_BT_NIMBLE_50_FEATURE_SUPPORT=y
CONFIG_BT_NIMBLE_LL_CFG_FEAT_LE_2M_PHY=y
CONFIG_BT_NIMBLE_LL_CFG_FEAT_LE_CODED_PHY=y
# CONFIG_BT_NIMBLE_EXT_SCAN is not set
CONFIG_BT_NIMBLE_HOST_ALLOW_CONNECT_WITH_SCAN=y
CONFIG_BT_NIMBLE_INCL_SVC_DISCOVERY=y
CONFIG_BT_NIMBLE_GATTC_AUTO_PAIR=y
CONFIG_BT_NIMBLE_ENABLE_CONN_REATTEMPT=y
CONFIG_BT_NIMBLE_MAX_CONN_REATTEMPT=5
CONFIG_BT_NIMBLE_WHITELIST_SIZE=16
CONFIG_BT_NIMBLE_EXTRA_ADV_FIELDS=y
# BLE/NimBLE on CPU0 (controller heap); LVGL on CPU1
CONFIG_BT_NIMBLE_PINNED_TO_CORE_0=y
CONFIG_BT_NIMBLE_PINNED_TO_CORE=0
CONFIG_BT_CTRL_PINNED_TO_CORE_0=y
CONFIG_BT_CTRL_PINNED_TO_CORE=0

# BLE scan can defer ISRs on CPU0 (NimBLE) — needs headroom during RF ops
CONFIG_ESP_INT_WDT_TIMEOUT_MS=10000
# CONFIG_ESP_INT_WDT_CHECK_CPU1 is not set

# Disable CPU1 idle WDT check during long BLE connect
CONFIG_ESP_TASK_WDT_TIMEOUT_S=30
# CONFIG_ESP_TASK_WDT_CHECK_IDLE_TASK_CPU1 is not set
```

## sdkconfig.defaults
```kconfig
CONFIG_IDF_TARGET="esp32s3"

# Console
CONFIG_ESP_CONSOLE_USB_SERIAL_JTAG=y

# CPU / FreeRTOS
CONFIG_ESP_DEFAULT_CPU_FREQ_MHZ_240=y
CONFIG_FREERTOS_HZ=1000
CONFIG_COMPILER_OPTIMIZATION_PERF=y
CONFIG_COMPILER_CXX_EXCEPTIONS=y

# PSRAM (octal @ 80MHz)
CONFIG_SPIRAM=y
CONFIG_SPIRAM_MODE_OCT=y
CONFIG_SPIRAM_SPEED_80M=y
CONFIG_SPIRAM_XIP_FROM_PSRAM=y
CONFIG_ESP32S3_DATA_CACHE_LINE_64B=y

# Flash
CONFIG_ESPTOOLPY_FLASHSIZE_16MB=y
CONFIG_PARTITION_TABLE_CUSTOM=y

# Bluetooth NimBLE
CONFIG_BT_ENABLED=y
CONFIG_BT_NIMBLE_ENABLED=y
CONFIG_BT_BLUEDROID_ENABLED=n
CONFIG_BT_NIMBLE_ROLE_CENTRAL=y
CONFIG_BT_NIMBLE_ROLE_OBSERVER=y
CONFIG_BT_NIMBLE_MAX_CONNECTIONS=1
CONFIG_BT_NIMBLE_MEM_ALLOC_MODE_EXTERNAL=y

# Display panel - Waveshare ESP32-S3-Touch-LCD-2.1
CONFIG_ESP_PANEL_BOARD_DEFAULT_USE_SUPPORTED=y
CONFIG_ESP_PANEL_BOARD_MANUFACTURER_WAVESHARE=y
CONFIG_BOARD_WAVESHARE_ESP32_S3_TOUCH_LCD_2_1=y

# LVGL anti-tearing (mode 3: double-buffer + direct mode)
CONFIG_LVGL_PORT_AVOID_TEARING_MODE_3=y

# LVGL fonts & widgets
CONFIG_LV_USE_LOG=y
CONFIG_LV_LOG_PRINTF=y
CONFIG_LV_MEM_CUSTOM=y
CONFIG_LV_MEMCPY_MEMSET_STD=y
CONFIG_LV_FONT_MONTSERRAT_12=y
CONFIG_LV_FONT_MONTSERRAT_16=y
CONFIG_LV_FONT_MONTSERRAT_18=y
CONFIG_LV_FONT_MONTSERRAT_20=y
CONFIG_LV_FONT_MONTSERRAT_24=y
CONFIG_LV_FONT_MONTSERRAT_28=y
CONFIG_LV_FONT_MONTSERRAT_32=y
CONFIG_LV_FONT_MONTSERRAT_48=y
CONFIG_LV_USE_ARC=y
CONFIG_LV_USE_METER=y
CONFIG_LV_USE_ANIMIMG=y
CONFIG_LV_USE_FLEX=y
CONFIG_LV_USE_GRID=y
CONFIG_LV_USE_GESTURE=y
```
